/**
 * Project     : 6DOF arm
 * Author      : Vladimir V. Laykov aka Yago
 * Group       :
 * Mentor      : Lipko I.Y.
 * Date        :
 * Last modify :
 */

#include "backlash_compensator.h"

/**
 * Установка величины люфта для конкретного сервопривода.
 *
 * Люфт задаётся в градусах и зависит от:
 *   - качества редуктора сервопривода
 *   - износа шестерён и тяг
 *   - точности монтажа механической передачи
 *
 * Типичные значения:
 *   - Новые серво高质量: 0.5–1.0°
 *   - Бюджетные серво: 1.5–3.0°
 *   - Изношенные серво: до 5°
 *
 * @param servoId  индекс сервопривода (0–6)
 * @param degrees  величина люфта в градусах (0 = компенсация отключена)
 */
void BacklashCompensator::setBacklash(int servoId, float degrees) {
    if (servoId >= 0 && servoId < 7) {
        states[servoId].backlash = degrees;
    }
}

/**
 * Получение величины люфта для конкретного сервопривода.
 *
 * @param servoId  индекс сервопривода (0–6)
 * @return         величина люфта в градусах (0 если индекс недопустим)
 */
float BacklashCompensator::getBacklash(int servoId) const {
    if (servoId >= 0 && servoId < 7) {
        return states[servoId].backlash;
    }
    return 0;
}

/**
 * Компенсация целевого угла с учётом люфта сервопривода.
 *
 * ЛОГИКА АЛГОРИТМА:
 *
 * Сервоприводы с редуктором имеют механический люфт (зазор) между
 * шестернями. Когда серво меняет направление вращения, первые
 * несколько градусов поворота «съедаются» этим зазором — выходной
 * вал не движется, пока зазор не выбран.
 *
 * Алгоритм компенсации работает только при смене направления:
 *
 * ШАГ 1: Вычисление delta = targetAngle - currentAngle
 *   Это разница между желаемым и текущим углом.
 *
 * ШАГ 2: Определение направления движения (newDir)
 *   Используется порог 0.01° для фильтрации шума:
 *   - delta > 0.01°  → newDir = +1 (движение по часовой стрелке)
 *   - delta < -0.01° → newDir = -1 (движение против часовой стрелки)
 *   - иначе          → newDir = 0  (нет движения или слишком мало)
 *
 * ШАГ 3: Проверка условия смены направления
 *   Компенсация применяется ТОЛЬКО если:
 *   a) newDir ≠ 0 (есть реальное движение)
 *   b) newDir ≠ lastDirection (направление изменилось)
 *   c) lastDirection ≠ 0 (уже было движение ранее, т.е. не начальное состояние)
 *
 * ШАГ 4: Прибавление поправки
 *   targetAngle += backlash × newDir
 *   Поправка прибавляется в направлении НОВОГО движения,
 *   чтобы «протолкнуть» передачу через мёртвую зону люфта.
 *
 * ПРИМЕР:
 *   Серво: люфт = 2°, текущий угол = 90°, lastDirection = +1
 *   Команда: targetAngle = 45°
 *   delta = 45 - 90 = -45° → newDir = -1
 *   newDir (-1) ≠ lastDirection (+1) → компенсация применяется
 *   targetAngle = 45 + 2×(-1) = 43°
 *   Серво получит команду 43°, реальный поворот = 90-43 = 47°
 *   Из них 2° — компенсация люфта, 45° — целевое перемещение.
 *
 * @param servoId     индекс сервопривода (0–6)
 * @param targetAngle целевой угол в градусах
 * @return            скорректированный угол с учётом люфта
 */
float BacklashCompensator::compensate(int servoId, float targetAngle) {
    // Проверка допустимости индекса сервопривода
    if (servoId < 0 || servoId >= 7) return targetAngle;

    // Ссылка на внутреннее состояние сервопривода
    ServoState &s = states[servoId];

    // Если люфт не задан (равен 0), компенсация не требуется
    if (s.backlash == 0) return targetAngle;

    // Вычисление разницы между целевым и текущим углом
    float delta = targetAngle - s.currentAngle;

    // Определение направления движения с порогом 0.01°
    // для фильтрации шума и предотвращения ложных срабатываний
    int newDir = 0;
    if (delta > 0.01f) newDir = 1;       // движение по часовой стрелке
    else if (delta < -0.01f) newDir = -1; // движение против часовой стрелки

    // Компенсация применяется ТОЛЬКО при смене направления:
    // 1) newDir ≠ 0 — есть реальное движение
    // 2) newDir ≠ lastDirection — направление изменилось
    // 3) lastDirection ≠ 0 — уже было движение ранее (не начальное состояние)
    if (newDir != 0 && newDir != s.lastDirection && s.lastDirection != 0) {
        // Прибавление поправки: люфт × направление нового движения
        // Поправка «проталкивает» передачу через мёртвую зону люфта
        targetAngle += s.backlash * newDir;
    }

    return targetAngle;
}

/**
 * Обновление направления движения после завершения перемещения.
 *
 * Этот метод должен вызываться ПОСЛЕ фактического перемещения сервопривода,
 * чтобы обновить внутреннее состояние компенсатора.
 *
 * Алгоритм:
 * 1. Вычисляется delta = currentAngle - previousAngle
 * 2. Определяется направление по порогу 0.01°:
 *    - delta > 0.01°  → lastDirection = +1
 *    - delta < -.01°  → lastDirection = -1
 *    - иначе          → lastDirection не изменяется
 * 3. Запоминается новый текущий угол.
 *
 * ВАЖНО: если delta меньше порога 0.01°, направление НЕ обновляется.
 * Это предотвращает «дрожание» направления при микроскопических
 * перемещениях, вызванных шумом или вибрацией.
 *
 * @param servoId      индекс сервопривода (0–6)
 * @param currentAngle фактический текущий угол сервопривода
 */
void BacklashCompensator::updateDirection(int servoId, float currentAngle) {
    if (servoId < 0 || servoId >= 7) return;

    // Ссылка на внутреннее состояние сервопривода
    ServoState &s = states[servoId];

    // Вычисление разницы углов для определения направления
    float delta = currentAngle - s.currentAngle;

    // Определение направления с порогом 0.01° (фильтрация шума)
    if (delta > 0.01f) s.lastDirection = 1;       // по часовой стрелке
    else if (delta < -0.01f) s.lastDirection = -1; // против часовой стрелки

    // Сохранение текущего угла для последующих вычислений
    s.currentAngle = currentAngle;
}

/**
 * Массовая установка люфта для всех 7 сервоприводов.
 *
 * Удобный метод для загрузки конфигурации из массива.
 * Используется, например, при загрузке параметров из EEPROM.
 *
 * @param backlash  массив из 7 элементов с величинами люфта в градусах
 */
void BacklashCompensator::setAll(const float backlash[7]) {
    for (int i = 0; i < 7; i++) {
        states[i].backlash = backlash[i];
    }
}

/**
 * Массовое получение люфта для всех 7 сервоприводов.
 *
 * Удобный метод для сохранения конфигурации в массив.
 *
 * @param backlash  массив из 7 элементов для записи величин люфта
 */
void BacklashCompensator::getAll(float backlash[7]) const {
    for (int i = 0; i < 7; i++) {
        backlash[i] = states[i].backlash;
    }
}
